## CMakeLists.txt
```
cmake_minimum_required(VERSION 3.20.0)

# Zephyr Utilities: retain automatic overlays and add this application's editable overlay.
if(NOT DEFINED ZEPHYR_UTILS_DEFAULT_OVERLAY)
  if(DEFINED DTC_OVERLAY_FILE)
    set(ZEPHYR_UTILS_DEFAULT_OVERLAY OFF CACHE BOOL "Include the generated default application overlay")
  else()
    set(ZEPHYR_UTILS_DEFAULT_OVERLAY ON CACHE BOOL "Include the generated default application overlay")
  endif()
endif()
if(ZEPHYR_UTILS_DEFAULT_OVERLAY AND "${BOARD}" STREQUAL "esp32s3_zero/esp32s3/procpu")
  list(PREPEND EXTRA_DTC_OVERLAY_FILE "${CMAKE_CURRENT_SOURCE_DIR}/overlays/esp32s3_zero_esp32s3_procpu.overlay")
endif()
# End Zephyr Utilities default overlay.


find_package(Zephyr REQUIRED HINTS $ENV{ZEPHYR_BASE})
project(zero_blink LANGUAGES C)

# Protobuf contract (copied from documentation/spec/motion.proto and
# documentation/scripts/contract/motion.options), encoded with nanopb.
list(APPEND CMAKE_MODULE_PATH ${ZEPHYR_BASE}/modules/nanopb)
include(nanopb)
zephyr_nanopb_sources(app proto/motion.proto)

target_sources(app PRIVATE
  src/main.c
  src/imu.c
  src/motion_codec.c
  src/udp_sender.c
  src/wifi.c
)
```

## prj.conf
```kconfig
# Application configuration, independent of board selection.
CONFIG_PRINTK=y
CONFIG_LED_STRIP=y
CONFIG_LOG=y
CONFIG_CBPRINTF_FP_SUPPORT=y

# MPU-6050 over I2C (polling; data-ready interrupts need CONFIG_MPU6050_TRIGGER_OWN_THREAD)
CONFIG_I2C=y
CONFIG_SENSOR=y
CONFIG_MPU6050=y
CONFIG_MPU6050_TRIGGER_NONE=y

# Protobuf encoding (spec/motion.proto)
CONFIG_NANOPB=y

# Wi-Fi station with DHCPv4 and UDP sockets
CONFIG_WIFI=y
CONFIG_NETWORKING=y
CONFIG_NET_IPV4=y
CONFIG_NET_IPV6=n
CONFIG_NET_UDP=y
CONFIG_NET_TCP=n
CONFIG_NET_DHCPV4=y
CONFIG_NET_SOCKETS=y
CONFIG_NET_MGMT=y
CONFIG_NET_MGMT_EVENT=y
CONFIG_NET_MGMT_EVENT_INFO=y
CONFIG_NET_MGMT_EVENT_QUEUE_SIZE=16

# Randomness for the per-boot session ID (hardware RNG of the ESP32-S3)
CONFIG_ENTROPY_GENERATOR=y

# k_event for the Wi-Fi ready state
CONFIG_EVENTS=y

CONFIG_MAIN_STACK_SIZE=4096
CONFIG_SYSTEM_WORKQUEUE_STACK_SIZE=4096
```

## src/main.c
```c
// SPDX-License-Identifier: MIT
//
// zero_blink: lets the onboard WS2812 RGB LED of the Waveshare ESP32-S3-Zero
// cycle through red, green and blue (GPIO21, driven via SPI2 / led_strip).
// Starts Wi-Fi; IMU acquisition (imu.c) and UDP sending (udp_sender.c) run in
// their own threads.
#include <zephyr/kernel.h>
#include <zephyr/device.h>
#include <zephyr/drivers/led_strip.h>

#include "wifi.h"

#define STRIP_NODE      DT_ALIAS(led_strip)
#define STRIP_NUM_PIXELS DT_PROP(STRIP_NODE, chain_length)
#define BLINK_MS        500
#define BRIGHTNESS      0x20 // keep it low, the LED is very bright

static const struct device *const strip = DEVICE_DT_GET(STRIP_NODE);

static const struct led_rgb colors[] = {
	{ .r = BRIGHTNESS, .g = 0x00, .b = 0x00 },
	{ .r = 0x00, .g = BRIGHTNESS, .b = 0x00 },
	{ .r = 0x00, .g = 0x00, .b = BRIGHTNESS },
};

int main(void)
{
	struct led_rgb pixels[STRIP_NUM_PIXELS];
	size_t i = 0;

	if (!device_is_ready(strip)) {
		printk("LED strip %s is not ready\n", strip->name);
		return 0;
	}
	printk("zero_blink running on %s\n", CONFIG_BOARD_TARGET);
	wifi_start();

	while (1) {
		for (size_t p = 0; p < STRIP_NUM_PIXELS; p++) {
			pixels[p] = colors[i];
		}
		int rc = led_strip_update_rgb(strip, pixels, STRIP_NUM_PIXELS);

		if (rc) {
			printk("led_strip_update_rgb failed: %d\n", rc);
		}
		i = (i + 1) % ARRAY_SIZE(colors);
		k_msleep(BLINK_MS);
	}
	return 0;
}
```

## src/app_config.h
```c
// SPDX-License-Identifier: MIT
//
// Application settings for the controller test firmware.
// Wi-Fi credentials are kept separately in wifi_credentials.h (not committed).

#ifndef APP_CONFIG_H_
#define APP_CONFIG_H_

// Provisioned numeric node ID of this controller (Envelope.sender_id and
// Transaction.controller_id). Must be nonzero and unique per controller.
#define APP_CONTROLLER_ID 1

// Identifier of this controller's local monotonic clock (Envelope.clock_id and
// ControllerInput.capture.clock_id). Placeholder until the clock-mapping contract
// assigns IDs.
#define APP_CLOCK_ID 1

// Receiver of controller_input messages (the Raspberry Pi), see docs/protocol.md.
// For tests this can be any PC on the same network running a UDP listener.
#define APP_RECEIVER_IPV4 "192.168.1.100"
#define APP_RECEIVER_PORT 41000

#endif // APP_CONFIG_H_
```

## src/imu.c
```c
// SPDX-License-Identifier: MIT
//
// IMU acquisition thread: reads the MPU-6050 (or generates test data) at a fixed
// rate and queues one sample per sampling boundary for the UDP sender.

#include <math.h>
#include <zephyr/kernel.h>
#include <zephyr/device.h>
#include <zephyr/drivers/sensor.h>
#include <zephyr/logging/log.h>

#include "imu.h"

LOG_MODULE_REGISTER(imu, LOG_LEVEL_INF);

// Sampling rate. The specification (spec/reference-profile.json, controller_hz)
// requires 200 Hz; 10 Hz is used for readable console tests.
#define IMU_SAMPLE_RATE_HZ 10

// 1: send generated data (no MPU-6050 needed), 0: read the real sensor.
#define IMU_USE_SIMULATED_DATA 1

// Full-scale ranges, must match accel-fs / gyro-fs in the overlay.
#define IMU_ACCEL_FULL_SCALE_M_S2 (16.0f * 9.80665f)
#define IMU_GYRO_FULL_SCALE_RAD_S (2000.0f * 3.14159265f / 180.0f)
#define IMU_SATURATION_FRACTION   0.98f

// Pending capacity from the specification (16 entries = 80 ms at 200 Hz).
#define IMU_QUEUE_LENGTH 16

#define IMU_THREAD_STACK_SIZE 2048
#define IMU_THREAD_PRIORITY   5

K_MSGQ_DEFINE(imu_msgq, sizeof(struct imu_sample), IMU_QUEUE_LENGTH, 8);
K_TIMER_DEFINE(imu_timer, NULL, NULL);

static atomic_t overloaded;

uint32_t imu_overloaded_count(void)
{
	return (uint32_t)atomic_get(&overloaded);
}

static uint64_t now_us(void)
{
	return k_ticks_to_us_floor64(k_uptime_ticks());
}

static bool is_saturated(const struct imu_sample *s)
{
	for (int i = 0; i < 3; i++) {
		if (fabsf(s->accel_m_s2[i]) >= IMU_SATURATION_FRACTION * IMU_ACCEL_FULL_SCALE_M_S2 ||
		    fabsf(s->gyro_rad_s[i]) >= IMU_SATURATION_FRACTION * IMU_GYRO_FULL_SCALE_RAD_S) {
			return true;
		}
	}
	return false;
}

#if IMU_USE_SIMULATED_DATA

// Generated data: device at rest with gravity on Z, plus a slow sinusoidal
// "swing" on X and a rotation around Z, so changing values are visible.
static int read_sample(struct imu_sample *s)
{
	float t = (float)s->t0_us / 1e6f;
	float swing = sinf(2.0f * 3.14159265f * 0.5f * t); // 0.5 Hz

	s->accel_m_s2[0] = 5.0f * swing;
	s->accel_m_s2[1] = 0.0f;
	s->accel_m_s2[2] = 9.80665f;
	s->gyro_rad_s[0] = 0.0f;
	s->gyro_rad_s[1] = 0.0f;
	s->gyro_rad_s[2] = 2.0f * swing;
	s->capture_us = now_us();
	s->simulated = true;
	return 0;
}

static bool imu_init(void)
{
	LOG_INF("Using simulated IMU data");
	return true;
}

#else // IMU_USE_SIMULATED_DATA

static const struct device *const imu = DEVICE_DT_GET(DT_ALIAS(imu0));

static int read_sample(struct imu_sample *s)
{
	struct sensor_value accel[3];
	struct sensor_value gyro[3];

	s->capture_us = now_us();
	int rc = sensor_sample_fetch(imu);

	if (rc != 0) {
		return rc;
	}
	sensor_channel_get(imu, SENSOR_CHAN_ACCEL_XYZ, accel);
	sensor_channel_get(imu, SENSOR_CHAN_GYRO_XYZ, gyro);
	for (int i = 0; i < 3; i++) {
		s->accel_m_s2[i] = (float)sensor_value_to_double(&accel[i]);
		s->gyro_rad_s[i] = (float)sensor_value_to_double(&gyro[i]);
	}
	s->simulated = false;
	return 0;
}

static bool imu_init(void)
{
	if (!device_is_ready(imu)) {
		LOG_ERR("%s not ready, check wiring and I2C address", imu->name);
		return false;
	}
	LOG_INF("Using %s", imu->name);
	return true;
}

#endif // IMU_USE_SIMULATED_DATA

static void imu_thread(void *p1, void *p2, void *p3)
{
	ARG_UNUSED(p1);
	ARG_UNUSED(p2);
	ARG_UNUSED(p3);

	uint64_t sample_id = 0;
	uint32_t missed = 0;
	uint32_t errors = 0;

	if (!imu_init()) {
		return;
	}
	LOG_INF("Sampling at %d Hz", IMU_SAMPLE_RATE_HZ);

	k_timer_start(&imu_timer, K_USEC(USEC_PER_SEC / IMU_SAMPLE_RATE_HZ),
		      K_USEC(USEC_PER_SEC / IMU_SAMPLE_RATE_HZ));

	while (true) {
		// Blocks until the next sampling boundary; > 1 means boundaries were missed.
		uint32_t expired = k_timer_status_sync(&imu_timer);
		struct imu_sample s = { 0 };

		s.t0_us = now_us();
		s.sample_id = ++sample_id;
		if (expired > 1) {
			missed += expired - 1;
			LOG_WRN("Missed %u sampling boundaries (total %u)", expired - 1, missed);
		}

		int rc = read_sample(&s);

		if (rc != 0) {
			errors++;
			LOG_WRN("Sample %llu: read failed (%d), errors=%u", s.sample_id, rc, errors);
			continue;
		}
		s.saturated = is_saturated(&s);

		// Never block the sampling thread; a full queue is counted as overload.
		if (k_msgq_put(&imu_msgq, &s, K_NO_WAIT) != 0) {
			atomic_inc(&overloaded);
		}
	}
}

K_THREAD_DEFINE(imu_tid, IMU_THREAD_STACK_SIZE, imu_thread, NULL, NULL, NULL,
		IMU_THREAD_PRIORITY, 0, 0);
```

## src/imu.h
```c
// SPDX-License-Identifier: MIT

#ifndef IMU_H_
#define IMU_H_

#include <stdbool.h>
#include <stdint.h>
#include <zephyr/kernel.h>

// One regular IMU sampling boundary (one controller_input transaction).
struct imu_sample {
	uint64_t sample_id;     // Starts at 1, increments per sampling boundary
	uint64_t t0_us;         // Sampling boundary on the local monotonic clock
	uint64_t capture_us;    // Time the sensor data was read
	float accel_m_s2[3];    // Specific force including gravity
	float gyro_rad_s[3];    // Angular velocity
	bool saturated;         // Any axis at or near the configured full scale
	bool simulated;         // Generated data instead of the MPU-6050
};

// Filled by the IMU thread, consumed by the UDP sender thread.
extern struct k_msgq imu_msgq;

// Number of samples that could not be queued because the queue was full.
uint32_t imu_overloaded_count(void);

#endif // IMU_H_
```

## src/motion_codec.c
```c
// SPDX-License-Identifier: MIT

#include <errno.h>
#include <string.h>
#include <zephyr/kernel.h>
#include <zephyr/logging/log.h>
#include <zephyr/random/random.h>

#include <pb_encode.h>
#include "proto/motion.pb.h"

#include "app_config.h"
#include "motion_codec.h"

LOG_MODULE_REGISTER(motion_codec, LOG_LEVEL_INF);

#define PROTOCOL_MAJOR 0
#define PROTOCOL_MINOR 3
#define UUID_SIZE      16
// Every uint64 on the wire is limited to 2^56 - 1 (docs/protocol.md).
#define WIRE_UINT64_MAX ((1ULL << 56) - 1)

static uint8_t session_id[UUID_SIZE];
static uint64_t message_seq;

// The Envelope is a large union (all message types); keep it out of thread stacks.
static motion_v03_Envelope envelope;

void motion_codec_init(void)
{
	// A new session at every boot; IDs and counters are never reused across restarts.
	sys_rand_get(session_id, sizeof(session_id));
	message_seq = 0;
	LOG_HEXDUMP_INF(session_id, sizeof(session_id), "Sender session ID");
}

static uint64_t now_us(void)
{
	return k_ticks_to_us_floor64(k_uptime_ticks());
}

int motion_encode_controller_input(const struct imu_sample *sample, uint8_t *buf,
				   size_t buf_size, size_t *out_len)
{
	if (sample->sample_id > WIRE_UINT64_MAX || message_seq >= WIRE_UINT64_MAX) {
		// The session must be replaced before reaching the wire limit.
		return -EOVERFLOW;
	}

	envelope = (motion_v03_Envelope)motion_v03_Envelope_init_zero;

	envelope.major = PROTOCOL_MAJOR;
	envelope.minor = PROTOCOL_MINOR;
	envelope.sender_id = APP_CONTROLLER_ID;
	envelope.sender_session_id.size = UUID_SIZE;
	memcpy(envelope.sender_session_id.bytes, session_id, UUID_SIZE);
	envelope.message_seq = ++message_seq;
	envelope.clock_id = APP_CLOCK_ID;
	// run_id is assigned by the control plane for a measurement run; not available
	// yet, so a 16-byte all-zero placeholder is sent.
	envelope.run_id.size = UUID_SIZE;

	envelope.which_body = motion_v03_Envelope_controller_input_tag;
	motion_v03_ControllerInput *in = &envelope.body.controller_input;

	in->has_transaction = true;
	in->transaction.controller_id = APP_CONTROLLER_ID;
	in->transaction.session_id.size = UUID_SIZE;
	memcpy(in->transaction.session_id.bytes, session_id, UUID_SIZE);
	in->transaction.request_seq = sample->sample_id;

	in->t0_us = sample->t0_us;
	in->sample_id = sample->sample_id;

	// Polling read: the time the driver read the data, not a hardware capture.
	// Uncertainty is one sampling period of the sensor (200 Hz).
	in->has_capture = true;
	in->capture.value_us = sample->capture_us;
	in->capture.clock_id = APP_CLOCK_ID;
	in->capture.kind = motion_v03_TimeKind_DRIVER_FRAME;
	in->capture.uncertainty_us = 5000;
	in->capture.timing_valid = true;

	// The MPU-6050 has no sensor timestamp; 0 (field absent).
	in->original_sensor_ticks = 0;
	// Association and calibration are not implemented yet (0 = not set).
	in->association_version = 0;
	in->calibration_id = 0;

	in->has_specific_force_m_s2 = true;
	in->specific_force_m_s2.x = sample->accel_m_s2[0];
	in->specific_force_m_s2.y = sample->accel_m_s2[1];
	in->specific_force_m_s2.z = sample->accel_m_s2[2];
	in->has_angular_velocity_rad_s = true;
	in->angular_velocity_rad_s.x = sample->gyro_rad_s[0];
	in->angular_velocity_rad_s.y = sample->gyro_rad_s[1];
	in->angular_velocity_rad_s.z = sample->gyro_rad_s[2];
	in->sensor_saturated = sample->saturated;
	// No battery measurement yet (0 = unknown).
	in->battery_millivolts = 0;

	// Set last so it is as close as possible to the actual send.
	envelope.sent_time_us = now_us();

	pb_ostream_t stream = pb_ostream_from_buffer(buf, MIN(buf_size, MOTION_MAX_UDP_BYTES));

	if (!pb_encode(&stream, motion_v03_Envelope_fields, &envelope)) {
		LOG_ERR("Encoding failed: %s", PB_GET_ERROR(&stream));
		return -EMSGSIZE;
	}
	*out_len = stream.bytes_written;
	return 0;
}
```

## src/motion_codec.h
```c
// SPDX-License-Identifier: MIT
//
// Encodes IMU samples as motion.v03.Envelope { controller_input } (spec/motion.proto).

#ifndef MOTION_CODEC_H_
#define MOTION_CODEC_H_

#include <stddef.h>
#include <stdint.h>

#include "imu.h"

// Maximum UDP payload for controller messages (docs/protocol.md).
#define MOTION_MAX_UDP_BYTES 1200

// Creates a fresh 16-byte sender session ID. Call once at boot.
void motion_codec_init(void);

// Encodes one sample. Returns 0 and sets *out_len, or a negative errno.
int motion_encode_controller_input(const struct imu_sample *sample, uint8_t *buf,
				   size_t buf_size, size_t *out_len);

#endif // MOTION_CODEC_H_
```

## src/udp_sender.c
```c
// SPDX-License-Identifier: MIT
//
// UDP sender thread: takes queued IMU samples, encodes each one as
// motion.v03.Envelope { controller_input } and sends it once to the receiver.
// Input UDP is not retransmitted (docs/controller.md).

#include <errno.h>
#include <zephyr/kernel.h>
#include <zephyr/logging/log.h>
#include <zephyr/net/socket.h>

#include "app_config.h"
#include "imu.h"
#include "motion_codec.h"
#include "wifi.h"

LOG_MODULE_REGISTER(udp_sender, LOG_LEVEL_INF);

// Print one status line per N samples (1 at 10 Hz; e.g. 20 at 200 Hz).
#define SENDER_PRINT_DIVIDER 1

#define SENDER_THREAD_STACK_SIZE 4096
#define SENDER_THREAD_PRIORITY   6

static uint8_t tx_buf[MOTION_MAX_UDP_BYTES];

static int open_socket(struct sockaddr_in *dst)
{
	dst->sin_family = AF_INET;
	dst->sin_port = htons(APP_RECEIVER_PORT);
	if (zsock_inet_pton(AF_INET, APP_RECEIVER_IPV4, &dst->sin_addr) != 1) {
		LOG_ERR("Invalid receiver address %s", APP_RECEIVER_IPV4);
		return -EINVAL;
	}

	int sock = zsock_socket(AF_INET, SOCK_DGRAM, IPPROTO_UDP);

	if (sock < 0) {
		LOG_ERR("socket() failed (%d)", errno);
		return -errno;
	}
	return sock;
}

static void sender_thread(void *p1, void *p2, void *p3)
{
	ARG_UNUSED(p1);
	ARG_UNUSED(p2);
	ARG_UNUSED(p3);

	struct sockaddr_in dst;
	struct imu_sample s;
	uint32_t sent = 0;
	uint32_t not_sent = 0;
	int sock;

	motion_codec_init();

	sock = open_socket(&dst);
	if (sock < 0) {
		return;
	}
	LOG_INF("Sending controller_input to %s:%d", APP_RECEIVER_IPV4, APP_RECEIVER_PORT);

	while (true) {
		k_msgq_get(&imu_msgq, &s, K_FOREVER);

		size_t len = 0;
		int rc = motion_encode_controller_input(&s, tx_buf, sizeof(tx_buf), &len);

		if (rc != 0) {
			not_sent++;
			LOG_ERR("Sample %llu: encode failed (%d)", s.sample_id, rc);
			continue;
		}

		if (!wifi_is_ready()) {
			// Encoded but no network: counted, not buffered for later.
			not_sent++;
		} else if (zsock_sendto(sock, tx_buf, len, ZSOCK_MSG_DONTWAIT,
					(struct sockaddr *)&dst, sizeof(dst)) < 0) {
			not_sent++;
			LOG_WRN("Sample %llu: sendto failed (%d)", s.sample_id, errno);
		} else {
			sent++;
		}

		if ((s.sample_id % SENDER_PRINT_DIVIDER) == 0) {
			printk("#%llu %s %u B | a %6.2f %6.2f %6.2f | g %5.2f %5.2f %5.2f%s | "
			       "sent=%u not_sent=%u overload=%u\n",
			       s.sample_id, s.simulated ? "SIM" : "IMU", (unsigned int)len,
			       (double)s.accel_m_s2[0], (double)s.accel_m_s2[1],
			       (double)s.accel_m_s2[2], (double)s.gyro_rad_s[0],
			       (double)s.gyro_rad_s[1], (double)s.gyro_rad_s[2],
			       s.saturated ? " SAT" : "", sent, not_sent, imu_overloaded_count());
		}
	}
}

K_THREAD_DEFINE(sender_tid, SENDER_THREAD_STACK_SIZE, sender_thread, NULL, NULL, NULL,
		SENDER_THREAD_PRIORITY, 0, 0);
```

## src/wifi.c
```c
// SPDX-License-Identifier: MIT
//
// Wi-Fi station: connects with WPA2-PSK, obtains an address via DHCPv4,
// disables power save for low latency and reconnects after a disconnect.

#include <string.h>
#include <zephyr/kernel.h>
#include <zephyr/logging/log.h>
#include <zephyr/net/net_if.h>
#include <zephyr/net/net_mgmt.h>
#include <zephyr/net/net_event.h>
#include <zephyr/net/wifi_mgmt.h>

#include "wifi.h"
#include "wifi_credentials.h"

LOG_MODULE_REGISTER(wifi, LOG_LEVEL_INF);

#define WIFI_RECONNECT_DELAY K_SECONDS(5)

#define WIFI_EVENTS (NET_EVENT_WIFI_CONNECT_RESULT | NET_EVENT_WIFI_DISCONNECT_RESULT)
#define IPV4_EVENTS (NET_EVENT_IPV4_ADDR_ADD | NET_EVENT_IPV4_ADDR_DEL)

#define EVT_READY BIT(0)

static struct net_mgmt_event_callback wifi_cb;
static struct net_mgmt_event_callback ipv4_cb;
static K_EVENT_DEFINE(wifi_events);

static void connect_work_handler(struct k_work *work);
static K_WORK_DELAYABLE_DEFINE(connect_work, connect_work_handler);

static void disable_power_save(struct net_if *iface)
{
	// Modem sleep adds latency to every packet (docs/hardware.md).
	struct wifi_ps_params ps = {
		.enabled = WIFI_PS_DISABLED,
		.type = WIFI_PS_PARAM_STATE,
	};

	if (net_mgmt(NET_REQUEST_WIFI_PS, iface, &ps, sizeof(ps)) != 0) {
		LOG_WRN("Could not disable power save");
	}
}

static void connect_work_handler(struct k_work *work)
{
	ARG_UNUSED(work);

	struct net_if *iface = net_if_get_wifi_sta();

	if (iface == NULL) {
		iface = net_if_get_default();
	}

	struct wifi_connect_req_params params = {
		.ssid = (const uint8_t *)WIFI_SSID,
		.ssid_length = strlen(WIFI_SSID),
		.psk = (const uint8_t *)WIFI_PASSWORD,
		.psk_length = strlen(WIFI_PASSWORD),
		.security = WIFI_SECURITY_TYPE_PSK,
		.channel = WIFI_CHANNEL_ANY,
		.band = WIFI_FREQ_BAND_2_4_GHZ,
		.mfp = WIFI_MFP_OPTIONAL,
		.timeout = SYS_FOREVER_MS,
	};

	LOG_INF("Connecting to \"%s\"...", WIFI_SSID);
	int rc = net_mgmt(NET_REQUEST_WIFI_CONNECT, iface, &params, sizeof(params));

	if (rc != 0) {
		LOG_ERR("Connect request failed (%d), retrying", rc);
		k_work_reschedule(&connect_work, WIFI_RECONNECT_DELAY);
	}
}

static void wifi_event_handler(struct net_mgmt_event_callback *cb, uint64_t event,
			       struct net_if *iface)
{
	const struct wifi_status *status = (const struct wifi_status *)cb->info;

	switch (event) {
	case NET_EVENT_WIFI_CONNECT_RESULT:
		if (status->status != 0) {
			LOG_ERR("Connection failed (%d), retrying", status->status);
			k_work_reschedule(&connect_work, WIFI_RECONNECT_DELAY);
		} else {
			LOG_INF("Connected, waiting for DHCP");
			disable_power_save(iface);
		}
		break;
	case NET_EVENT_WIFI_DISCONNECT_RESULT:
		LOG_WRN("Disconnected (%d), reconnecting", status->status);
		k_event_clear(&wifi_events, EVT_READY);
		k_work_reschedule(&connect_work, WIFI_RECONNECT_DELAY);
		break;
	default:
		break;
	}
}

static void ipv4_event_handler(struct net_mgmt_event_callback *cb, uint64_t event,
			       struct net_if *iface)
{
	ARG_UNUSED(cb);

	if (event == NET_EVENT_IPV4_ADDR_ADD) {
		char addr[NET_IPV4_ADDR_LEN];
		struct net_if_ipv4 *ipv4 = iface->config.ip.ipv4;

		if (ipv4 != NULL) {
			net_addr_ntop(AF_INET, &ipv4->unicast[0].ipv4.address.in_addr, addr,
				      sizeof(addr));
			LOG_INF("IPv4 address: %s", addr);
		}
		k_event_post(&wifi_events, EVT_READY);
	} else if (event == NET_EVENT_IPV4_ADDR_DEL) {
		k_event_clear(&wifi_events, EVT_READY);
	}
}

void wifi_start(void)
{
	net_mgmt_init_event_callback(&wifi_cb, wifi_event_handler, WIFI_EVENTS);
	net_mgmt_add_event_callback(&wifi_cb);
	net_mgmt_init_event_callback(&ipv4_cb, ipv4_event_handler, IPV4_EVENTS);
	net_mgmt_add_event_callback(&ipv4_cb);

	k_work_reschedule(&connect_work, K_NO_WAIT);
}

bool wifi_wait_ready(k_timeout_t timeout)
{
	return k_event_wait(&wifi_events, EVT_READY, false, timeout) != 0;
}

bool wifi_is_ready(void)
{
	return (k_event_test(&wifi_events, EVT_READY) & EVT_READY) != 0;
}
```

## src/wifi.h
```c
// SPDX-License-Identifier: MIT

#ifndef WIFI_H_
#define WIFI_H_

#include <stdbool.h>
#include <zephyr/kernel.h>

// Starts the station connection with the credentials from wifi_credentials.h.
// Reconnects automatically after a disconnect.
void wifi_start(void);

// Waits until the station is connected and has an IPv4 address.
// Returns true if the network is ready within the timeout.
bool wifi_wait_ready(k_timeout_t timeout);

// True while connected with an IPv4 address.
bool wifi_is_ready(void);

#endif // WIFI_H_
```
